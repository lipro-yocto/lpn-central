## meta-cedi/conf/bblayers.conf.sample
```bitbake
# CEDI_BBLAYERS_CONF_VERSION is increased each time build/conf/bblayers.conf
# changes incompatibly, also REQUIRED_CEDI_BBLAYERS_CONF_VERSION in all other
# layer.conf should be increased at be the same value.
CEDI_BBLAYERS_CONF_VERSION = "1"

BBPATH = "${TOPDIR}"
BSPDIR := "${@os.path.abspath('##OEROOT##/../..')}"
BBFILES ?= ""

BBLAYERS = " \
  ${BSPDIR}/sources/poky/meta \
  ${BSPDIR}/sources/poky/meta-poky \
  ${BSPDIR}/sources/poky/meta-yocto-bsp \
  \
  ${BSPDIR}/sources/openembedded/meta-oe \
  ${BSPDIR}/sources/openembedded/meta-python \
  ${BSPDIR}/sources/openembedded/meta-initramfs \
  ${BSPDIR}/sources/openembedded/meta-filesystems \
  ${BSPDIR}/sources/openembedded/meta-networking \
  ${BSPDIR}/sources/openembedded/meta-multimedia \
  \
  ${BSPDIR}/sources/central/meta \
  ${BSPDIR}/sources/central/meta-cedi \
"
```

## meta-cedi/conf/layer.conf
```bitbake
# We have a conf and classes directory, add to BBPATH
BBPATH =. "${LAYERDIR}:"

# We have recipes-* directories, add to BBFILES
BBFILES += "${LAYERDIR}/recipes-*/*/*.bb \
            ${LAYERDIR}/recipes-*/*/*.bbappend"

BBFILE_COLLECTIONS += "cedi"
BBFILE_PATTERN_cedi = "^${LAYERDIR}/"
BBFILE_PRIORITY_cedi = "6"

LAYERSERIES_COMPAT_cedi = "gatesgarth dunfell zeus warrior"

# This should only be incremented on significant changes that will
# cause compatibility issues with other layers
LAYERVERSION_cedi = "1"

LAYERDEPENDS_cedi = "central-core (>= 1)"
LAYERDEPENDS_cedi += "meta-python"
LAYERDEPENDS_cedi += "meta-initramfs"
LAYERDEPENDS_cedi += "filesystems-layer"
LAYERDEPENDS_cedi += "networking-layer"
LAYERDEPENDS_cedi += "multimedia-layer"
REQUIRED_CEDI_BBLAYERS_CONF_VERSION = "1"
```

## meta-lpn-bsp/conf/layer.conf
```bitbake
# We have a conf and classes directory, add to BBPATH
BBPATH .= ":${LAYERDIR}"

# We have recipes-* directories, add to BBFILES
BBFILES += "${LAYERDIR}/recipes-*/*/*.bb \
            ${LAYERDIR}/recipes-*/*/*.bbappend"

BBFILE_COLLECTIONS += "lpn-bsp"
BBFILE_PATTERN_lpn-bsp = "^${LAYERDIR}/"
BBFILE_PRIORITY_lpn-bsp = "6"

LAYERSERIES_COMPAT_lpn-bsp = "gatesgarth dunfell zeus warrior"

# This should only be incremented on significant changes that will
# cause compatibility issues with other layers
LAYERVERSION_lpn-bsp = "1"

LAYERDEPENDS_lpn-bsp = "cedi (>= 1)"
LAYERDEPENDS_lpn-bsp += "yoctobsp (>= 4)"
REQUIRED_CEDI_BBLAYERS_CONF_VERSION = "1"
```

## meta-lpn-bsp/conf/machine/helium.conf
```bitbake
#@TYPE: Machine
#@NAME: QEMU x86-64 machine
#@SOC: qemux86-64
#@COM: helium
#@DESCRIPTION: Machine configuration for running an x86-64 system on QEMU (based on qemux86-64).
#@MAINTAINER: Stephan Linz <linz@li-pro.net>

require conf/machine/include/qemux86-64.inc
require conf/machine/include/lpn-emu.inc
```

## meta-lpn-bsp/conf/machine/hydrogen.conf
```bitbake
#@TYPE: Machine
#@NAME: QEMU x86 machine
#@SOC: qemux86
#@COM: hydrogen
#@DESCRIPTION: Machine configuration for running an x86 system on QEMU (based on qemux86).
#@MAINTAINER: Stephan Linz <linz@li-pro.net>

require conf/machine/include/qemux86.inc
require conf/machine/include/lpn-emu.inc
```

## meta-lpn-bsp/conf/machine/include/lpn-emu.inc
```bitbake
# Common definitions for Li-Pro.Net emulated systems

require conf/machine/include/lpn.inc

# is a Li-Pro.Net emulated system
MACHINEOVERRIDES_append = ":lpnemu"
```

## meta-lpn-bsp/conf/machine/include/lpn.inc
```bitbake
# Common definitions for Li-Pro.Net systems

# is a Li-Pro.Net system
MACHINEOVERRIDES_append = ":lpn"
```

## meta-lpn-bsp/conf/machine/include/qemux86-64.inc
```bitbake
# Common definitions for Yocto QEMU x86-64 machine

# derived from qemux86-64
require conf/machine/qemux86-64.conf
MACHINEOVERRIDES_prepend = "qemux86-64:"

# remap derived machine back to qemux86-64 for the Linux kernel
KMACHINE = "qemux86-64"
```

## meta-lpn-bsp/conf/machine/include/qemux86.inc
```bitbake
# Common definitions for Yocto QEMU x86 machine

# derived from qemux86
require conf/machine/qemux86.conf
MACHINEOVERRIDES_prepend = "qemux86:"

# derived this machine back to qemux86 for the Linux kernel
KMACHINE = "qemux86"
```

## meta/conf/layer.conf
```bitbake
# We have a conf and classes directory, add to BBPATH
BBPATH .= ":${LAYERDIR}"

# We have recipes-* directories, add to BBFILES
BBFILES += "${LAYERDIR}/recipes-*/*/*.bb \
            ${LAYERDIR}/recipes-*/*/*.bbappend"

BBFILE_COLLECTIONS += "central-core"
BBFILE_PATTERN_central-core = "^${LAYERDIR}/"
BBFILE_PRIORITY_central-core = "6"

LAYERSERIES_COMPAT_central-core = "gatesgarth dunfell zeus warrior"

# This should only be incremented on significant changes that will
# cause compatibility issues with other layers
LAYERVERSION_central-core = "1"

LAYERDEPENDS_central-core = "yocto (>= 3)"
LAYERDEPENDS_central-core += "meta-mingw"
LAYERDEPENDS_central-core += "openembedded-layer (>= 1)"
LAYERDEPENDS_central-core += "qt5-layer (>= 1)"

# Set a variable to get to the top of the metadata location
CENTRALCOREBASE = '${@os.path.normpath("${LAYERDIR}/../")}'

# Additional custom license directories.
# Add your custom licenses directories this path.
LICENSE_PATH += "${LAYERDIR}/files/custom-licenses"

CENTRAL_GIT_PROJECT ?= "lipro-yocto"
CENTRAL_GIT ?= "https://github.com/${CENTRAL_GIT_PROJECT}"
CENTRAL_GIT_PROTOCOL ?= "https"
```
